## tools/image-sd.its
```
/*
 * Copyright (C) 2020 Rockchip Electronic Co.,Ltd
 *
 * Simple UEFI fit source file containing ATF/OP-TEE/UEFI/dtb
 */

/dts-v1/;

/ {
	description = "FIT Image with ATF/TEE/UEFI";
	#address-cells = <1>;

	images {
		atf-1 {
			description = "ARM Trusted Firmware";
			data = /incbin/("./atf_0x00040000.bin");
			type = "firmware";
			arch = "arm64";
			os = "arm-trusted-firmware";
			compression = "none";
			load = <0x00040000>;
			hash {
				algo = "sha256";
			};
		};
		atf-2 {
			description = "ARM Trusted Firmware";
			data = /incbin/("./atf_0xff3b0000.bin");
			type = "firmware";
			arch = "arm64";
			os = "arm-trusted-firmware";
			compression = "none";
			load = <0xff3b0000>;
			hash {
					algo = "sha256";
			};
		};
		atf-3 {
			description = "ARM Trusted Firmware";
			data = /incbin/("./atf_0xff8c0000.bin");
			type = "firmware";
			arch = "arm64";
			os = "arm-trusted-firmware";
			compression = "none";
			load = <0xff8c0000>;
			hash {
					algo = "sha256";
			};
		};
		atf-4 {
			description = "ARM Trusted Firmware";
			data = /incbin/("./atf_0xff8c1000.bin");
			type = "firmware";
			arch = "arm64";
			os = "arm-trusted-firmware";
			compression = "none";
			load = <0xff8c1000>;
			hash {
				algo = "sha256";
			};
		};
		tee-1 {
			description = "OP-TEE";
			data = /incbin/("./tee_0x30000000.bin");
			type = "firmware";
			arch = "arm64";
			os = "op-tee";
			compression = "none";
			load = <0x30000000>;
			hash {
				algo = "sha256";
			};
		};
		tee-2 {
			description = "OP-TEE";
			data = /incbin/("./tee_0x30200000.bin");
			type = "firmware";
			arch = "arm64";
			os = "op-tee";
			compression = "none";
			load = <0x30200000>;
			hash {
				algo = "sha256";
			};
		};
		uefi {
			description = "UEFI";
			data-position = <0x00100000>;
			data-size = <0x100000>;
			type = "standalone";
			arch = "arm64";
			os = "UEFI";
			compression = "none";
			load = <0x00A00000>;
		};
		fdt {
			description = "@BOARDTYPE@ dtb";
			data = /incbin/("../dtb/@BOARDTYPE@.dtb");
			type = "flat_dt";
			arch = "arm64";
			compression = "none";
			load = <0x00B00000>;
			hash {
				algo = "sha256";
			};
		};
	};

	configurations {
		default = "conf";
		conf {
			description = "@BOARDTYPE@";
			rollback-index = <0x0>;
			loadables = "atf-1", "atf-2", "atf-3", "atf-4", "tee-1", "tee-2", "uefi";
			fdt = "fdt";
			signature {
				algo = "sha256,rsa2048";
				padding = "pss";
				key-name-hint = "dev";
				sign-images = "fdt", "loadables";
			};
		};
	};
};
```

## tools/uefi.its
```
/*
 * Copyright (C) 2020 Rockchip Electronic Co.,Ltd
 *
 * Simple U-boot fit source file containing ATF/OP-TEE/UEFI/dtb
 */

/dts-v1/;

/ {
	description = "FIT Image with ATF/OP-TEE/UEFI";
	#address-cells = <1>;

	images {
		uboot {
			description = "UEFI";
			data-position = <0x00100000>;
			data-size = <0x100000>;
			type = "standalone";
			arch = "arm64";
			os = "U-Boot";
			compression = "none";
			load = <0x00a00000>;
		};
		atf-1 {
			description = "ARM Trusted Firmware";
			data = /incbin/("./bl31_0x00040000.bin");
			type = "firmware";
			arch = "arm64";
			os = "arm-trusted-firmware";
			compression = "none";
			load = <0x00040000>;
			hash {
				algo = "sha256";
			};
		};
		atf-2 {
				description = "ARM Trusted Firmware";
				data = /incbin/("./bl31_0xff8c0000.bin");
				type = "firmware";
				arch = "arm64";
				os = "arm-trusted-firmware";
				compression = "none";
				load = <0xff8c0000>;
				hash {
						algo = "sha256";
				};
		};
		atf-3 {
			description = "ARM Trusted Firmware";
			data = /incbin/("./bl31_0xff8c2000.bin");
			type = "firmware";
			arch = "arm64";
			os = "arm-trusted-firmware";
			compression = "none";
			load = <0xff8c2000>;
			hash {
				algo = "sha256";
			};
		};
		optee {
			description = "OP-TEE";
			data = /incbin/("../Silicon/Rockchip/rkbin/bin/rk33/rk3399_bl32_v2.10.bin");
			type = "firmware";
			arch = "arm64";
			os = "op-tee";
			compression = "none";
			load = <0x8400000>;
			hash {
				algo = "sha256";
			};
		};
		fdt {
			description = "UEFI dtb";
			data = /incbin/("../dtb/@BOARDTYPE@.dtb");
			type = "flat_dt";
			arch = "arm64";
			compression = "none";
			load = <0x00b00000>;
			hash {
				algo = "sha256";
			};
		};
	};

	configurations {
		default = "conf";
		conf {
			description = "@BOARDTYPE@";
			rollback-index = <0x0>;
			firmware = "atf-1";
			loadables = "uboot", "atf-2", "atf-3", "optee";
			
			fdt = "fdt";
			signature {
				algo = "sha256,rsa2048";
				padding = "pss";
				key-name-hint = "dev";
				sign-images = "fdt", "firmware", "loadables";
			};
		};
	};
};
```
